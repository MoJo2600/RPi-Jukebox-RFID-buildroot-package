## phoniebox/Config.in
```kconfig
menu "Phoniebox - RFID Music Player"

	config BR2_PACKAGE_PHONIEBOX
		bool "phoniebox"
		select BR2_PACKAGE_NODEJS
		help
		Implementation of the Phonibox/Jukebox from github.

		https://rpi-jukebox-rfid.readthedocs.io/en/latest/index.html
		https://github.com/net-attack/RPi-Jukebox-RFID-buildroot-package

	source "$BR2_EXTERNAL_PHONIEBOX_PATH/package/phoniebox-core/Config.in"
	source "$BR2_EXTERNAL_PHONIEBOX_PATH/package/phoniebox-webapp/Config.in"
endmenu

menu "Additional drivers, libraries and/or applications"
#	source "$BR2_EXTERNAL_PHONIEBOX_PATH/package/wifi-connect/Config.in"

	menu "Sound Drivers"
		source "$BR2_EXTERNAL_PHONIEBOX_PATH/package/soundcard-waveshare-wm8960/Config.in"
	endmenu
endmenu

menu "Additional external python modules"
	source "$BR2_EXTERNAL_PHONIEBOX_PATH/package/python-pulsectl/Config.in"
endmenu
```

## phoniebox/configs/raspberrypizero2w_defconfig
```kconfig
BR2_arm=y
BR2_cortex_a53=y
BR2_ARM_FPU_NEON_VFPV4=y
BR2_PACKAGE_HOST_LINUX_HEADERS_CUSTOM_6_1=y
BR2_TOOLCHAIN_BUILDROOT_CXX=y
BR2_CCACHE=y
BR2_TARGET_GENERIC_HOSTNAME="phoniebox"
BR2_TARGET_GENERIC_ISSUE="Welcome to Phoniebox"
BR2_ROOTFS_DEVICE_CREATION_DYNAMIC_MDEV=y
BR2_TARGET_GENERIC_ROOT_PASSWD="phoniebox"
BR2_SYSTEM_BIN_SH_ZSH=y
BR2_ROOTFS_POST_BUILD_SCRIPT="board/raspberrypizero2w/post-build.sh"
BR2_ROOTFS_POST_IMAGE_SCRIPT="board/raspberrypizero2w/post-image.sh"
BR2_LINUX_KERNEL=y
BR2_LINUX_KERNEL_CUSTOM_TARBALL=y
BR2_LINUX_KERNEL_CUSTOM_TARBALL_LOCATION="$(call github,raspberrypi,linux,ba774164c90ffbb005bed333e278b32c607e0bc6)/linux-ba774164c90ffbb005bed333e278b32c607e0bc6.tar.gz"
BR2_LINUX_KERNEL_USE_CUSTOM_CONFIG=y
BR2_LINUX_KERNEL_CUSTOM_CONFIG_FILE="$(BR2_EXTERNAL_PHONIEBOX_PATH)/board/raspberrypizero2w/linux-6.1.config"
BR2_LINUX_KERNEL_DTS_SUPPORT=y
BR2_LINUX_KERNEL_INTREE_DTS_NAME="bcm2710-rpi-zero-2-w"
BR2_LINUX_KERNEL_NEEDS_HOST_OPENSSL=y
BR2_PACKAGE_BUSYBOX_SHOW_OTHERS=y
BR2_PACKAGE_ALSA_UTILS=y
BR2_PACKAGE_ALSA_UTILS_ALSACONF=y
BR2_PACKAGE_ALSA_UTILS_APLAY=y
BR2_PACKAGE_ALSA_UTILS_SPEAKER_TEST=y
BR2_PACKAGE_MPD=y
BR2_PACKAGE_MPD_MPG123=y
BR2_PACKAGE_PULSEAUDIO=y
BR2_PACKAGE_RPI_FIRMWARE=y
BR2_PACKAGE_RPI_FIRMWARE_BOOTCODE_BIN=y
BR2_PACKAGE_RPI_FIRMWARE_VARIANT_PI=y
BR2_PACKAGE_RPI_FIRMWARE_CONFIG_FILE="$(BR2_EXTERNAL_PHONIEBOX_PATH)/board/raspberrypizero2w/config.txt"
BR2_PACKAGE_RPI_FIRMWARE_INSTALL_VCDBG=y
BR2_PACKAGE_I2C_TOOLS=y
BR2_PACKAGE_DROPBEAR=y
BR2_PACKAGE_OPENSSH=y
BR2_PACKAGE_WPA_SUPPLICANT=y
BR2_PACKAGE_BASH=y
BR2_PACKAGE_KMOD=y
BR2_PACKAGE_UTIL_LINUX=y
BR2_PACKAGE_UTIL_LINUX_LIBBLKID=y
BR2_TARGET_ROOTFS_EXT2=y
BR2_TARGET_ROOTFS_EXT2_4=y
BR2_TARGET_ROOTFS_EXT2_SIZE="120M"
# BR2_TARGET_ROOTFS_TAR is not set
BR2_PACKAGE_HOST_DOSFSTOOLS=y
BR2_PACKAGE_HOST_GENIMAGE=y
BR2_PACKAGE_HOST_MTOOLS=y
BR2_PACKAGE_SOUNDCARD_WAVESHARE_WM8960=y
```

## phoniebox/package/phoniebox-core/Config.in
```kconfig
if BR2_PACKAGE_PHONIEBOX

config BR2_PACKAGE_PHONIEBOX_CORE
	bool "phoniebox-core"
	default y
	select BR2_PACKAGE_ZEROMQ
	select BR2_PACKAGE_ZEROMQ_WEBSOCKET
	select BR2_PACKAGE_PYTHON_EVDEV
	select BR2_PACKAGE_PYTHON_MPD2
	select BR2_PACKAGE_PYTHON_REQUESTS
	select BR2_PACKAGE_PYTHON_TORNADO
	select BR2_PACKAGE_PYTHON_ALSAAUDIO
	select BR2_PACKAGE_PYTHON_PULSECTL
	select BR2_PACKAGE_PYTHON_PYZMQ
	select BR2_PACKAGE_PYTHON_RPI_GPIO
	select BR2_PACKAGE_PYTHON_GPIOZERO
	select BR2_PACKAGE_PYTHON_RUAMEL_YAML
	select BR2_PACKAGE_LIBSAMPLERATE
	select BR2_PACKAGE_ESPEAK
	select BR2_PACKAGE_FFMPEG
	select BR2_PACKAGE_MPG123
	depends on BR2_INIT_SYSTEMD
	help
	  Phoniebox core

endif
```

## phoniebox/package/phoniebox-webapp/Config.in
```kconfig
if BR2_PACKAGE_PHONIEBOX

config BR2_PACKAGE_PHONIEBOX_WEBAPP
	bool "phoniebox-webapp"
	default y
	select BR2_PACKAGE_NGINX
	select BR2_PACKAGE_NODEJS_NPM
	depends on BR2_PACKAGE_NODEJS || BR2_PACKAGE_HOST_NODEJS

endif # BR2_PACKAGE_PHONIEBOX
```

## phoniebox/package/soundcard-waveshare-wm8960/Config.in
```kconfig
config BR2_PACKAGE_SOUNDCARD_WAVESHARE_WM8960
	bool "soundcard_waveshare_wm8960"
	select BR2_PACKAGE_DTC
	select BR2_PACKAGE_DTC_PROGRAMS
	help
		Waveshare WM8960 audio hat.
		The kernel driver is not working for me in kernel 6.1.x
```
